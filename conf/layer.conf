## conf/layer.conf
```bitbake
BBFILES += "${LAYERDIR}/recipes/*/*.bb ${LAYERDIR}/recipes/*/*.bbappend ${LAYERDIR}/recipes-*/*/*.bb ${LAYERDIR}/recipes-*/*/*.bbappend"
BBPATH .= ":${LAYERDIR}"
BBFILE_COLLECTIONS += "qti-sepolicy"
BBFILE_PRIORITY_qti-sepolicy = "11"
BBFILE_PATTERN_qti-sepolicy := "^${LAYERDIR}/"

PREFERRED_VERSION_refpolicy-mls = "git"
SELINUX_FILE_CONTEXTS ?= "${IMAGE_ROOTFS}/etc/selinux/mls/contexts/files/file_contexts"
SELINUX_FILE_CONTEXTS_DATA ?= "${IMAGE_ROOTFS}/etc/selinux/mls/contexts/files/data_file_contexts"

LAYERVERSION_qti-sepolicy = "1"

LAYERDEPENDS_qti-sepolicy = " \
selinux \
"

UNPACKDIR ??= "${WORKDIR}"

LAYERSERIES_COMPAT_qti-sepolicy = "kirkstone scarthgap wrynose"
```
